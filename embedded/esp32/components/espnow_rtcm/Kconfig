## embedded/esp32/components/espnow_rtcm/Kconfig
```kconfig
menu "Experimental ESP-NOW RTCM bridge"
config ESPNOW_RTCM_BASE
    bool "Forward existing NTRIP client RTCM over ESP-NOW (Ethernet BASE only)"
    default n
config ESPNOW_RTCM_ROVER
    bool "Minimal ESP-NOW to USB Serial/JTAG ROVER"
    default n
    depends on SOC_USB_SERIAL_JTAG_SUPPORTED && !ESPNOW_RTCM_BASE
endmenu
```

## embedded/esp32/components/ug_web/Kconfig
```kconfig
# SPDX-License-Identifier: LGPL-3.0-only
menu "Universal GNSS administration"
    config UG_WEB_HTTP
        bool "Explicit experimental HTTP administration on the S3 LAN"
        depends on IDF_TARGET_ESP32S3
        default n
        help
            Selects HTTP at build time. Credentials and sessions cross the LAN
            without encryption. This is never a fallback from a TLS failure.
            Existing NVS identities and TLS for NTRIP are retained. Web Serial
            is unavailable from an HTTP LAN origin; use a separate USB tool.
endmenu
```

## embedded/esp32/native/tests/tls_boot/sdkconfig.defaults
```kconfig
CONFIG_IDF_TARGET="esp32s3"
CONFIG_ESPTOOLPY_FLASHSIZE_16MB=y
CONFIG_ESP_MAIN_TASK_STACK_SIZE=32768
CONFIG_SPIRAM=y
CONFIG_SPIRAM_MODE_OCT=y
CONFIG_SPIRAM_TYPE_ESPPSRAM64=y
CONFIG_SPIRAM_SPEED_80M=y
CONFIG_SPIRAM_USE_MALLOC=y
CONFIG_SPIRAM_MALLOC_ALWAYSINTERNAL=1024
CONFIG_MBEDTLS_EXTERNAL_MEM_ALLOC=y
CONFIG_MBEDTLS_X509_CREATE_C=y
CONFIG_MBEDTLS_X509_CRT_WRITE_C=y
CONFIG_MBEDTLS_PEM_WRITE_C=y
CONFIG_FREERTOS_GENERATE_RUN_TIME_STATS=y
CONFIG_FREERTOS_RUN_TIME_COUNTER_TYPE_U64=y
CONFIG_ESP_CONSOLE_UART_DEFAULT=y
CONFIG_COMPILER_OPTIMIZATION_SIZE=y
CONFIG_ESP_CONSOLE_SECONDARY_NONE=y
# CONFIG_ESP_ROM_CONSOLE_OUTPUT_SECONDARY is not set
```
